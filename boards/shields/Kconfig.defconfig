## boards/shields/Kconfig.defconfig
```kconfig
if SHIELD_CORNE_DONGLE

config ZMK_KEYBOARD_NAME
    default "Corne"

config ZMK_SPLIT_ROLE_CENTRAL
    default y

config ZMK_SPLIT
    default y

config ZMK_SPLIT_BLE_CENTRAL_PERIPHERALS
    default 3

config BT_MAX_CONN
    default 8

config BT_MAX_PAIRED
    default 8

endif
```

## config/boards/shields/corne/Kconfig.defconfig
```kconfig
if SHIELD_CORNE_DONGLE

config ZMK_SPLIT
    default y

config ZMK_SPLIT_ROLE_CENTRAL
    default y

config ZMK_BLE
    default y

config ZMK_USB
    default y
  
config ZMK_SPLIT_BLE_CENTRAL_PERIPHERALS
    default 2

endif
```

## config/boards/shields/corne_dongle/Kconfig.defconfig
```kconfig
if SHIELD_CORNE_DONGLE

config ZMK_KEYBOARD_NAME
    default "Corne"

config ZMK_SPLIT_ROLE_CENTRAL
    default y

config ZMK_SPLIT
    default y

config ZMK_SPLIT_BLE_CENTRAL_PERIPHERALS
    default 3  # Change to 3 for macropad

config BT_MAX_CONN
    default 8  # Change to 8 for macropad (3 peripherals + 5 profiles)

config BT_MAX_PAIRED
    default 8  # Change to 8 for macropad

endif
```

## config/boards/shields/corne_left/Kconfig.defconfig
```kconfig
if SHIELD_CORNE_LEFT

config ZMK_SPLIT_ROLE_CENTRAL
    default n

config BT_CENTRAL
    default n

config BT_PERIPHERAL
    default y

endif
```

## config/boards/shields/corne_right/Kconfig.defconfig
```kconfig
if SHIELD_CORNE_RIGHT

config ZMK_SPLIT_ROLE_CENTRAL
    default n

config BT_CENTRAL
    default n

config BT_PERIPHERAL
    default y

endif
```

## config/west.yml
```yaml
manifest:
  remotes:
    - name: zmkfirmware
      url-base: https://github.com/zmkfirmware
    - name: urob
      url-base: https://github.com/urob
      #for ZMK helper
    - name: englmaxi
      url-base: https://github.com/englmaxi
      #for the lovely dongle display module
  projects:
    - name: zmk
      remote: zmkfirmware
      revision: main
      import: app/west.yml
    - name: zmk-helpers
      remote: urob
      revision: main
    - name: zmk-dongle-display
      remote: englmaxi
      revision: main 
  self:
    path: config
```
