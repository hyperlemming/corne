/* 
Keyboard: Corne 6 column
Key positions:
  ╭────────────────────────┬────────────────────────╮ ╭─────────────────────────┬─────────────────────────╮
  │  0   1   2   3   4   5 │  6   7   8   9  10  11 │ │ LT5 LT4 LT3 LT2 LT1 LT0 │ RT0 RT1 RT2 RT3 RT4 RT5 │
  │ 12  13  14  15  16  17 │ 18  19  20  21  22  23 │ │ LM5 LM4 LM3 LM2 LM1 LM0 │ RM0 RM1 RM2 RM3 RM4 RM5 │
  │ 24  25  26  27  28  29 │ 30  31  32  33  34  35 │ │ LB5 LB4 LB3 LB2 LB1 LB0 │ RB0 RB1 RB2 RB3 RB4 RB5 │
  ╰───────────╮ 36  37  38 │ 39  40  41 ╭───────────╯ ╰───────────╮ LH2 LH1 LH0 │ RH0 RH1 RH2 ╭───────────╯
              ╰───────╮ 42 │ 43 ╭───────╯                         ╰───────╮ LE0 │ RE0 ╭───────╯            
                      ╰────┴────╯                                         ╰─────┴─────╯
*/

#include <behaviors.dtsi>
#include <dt-bindings/zmk/keys.h>
#include <dt-bindings/zmk/bt.h>
#include <dt-bindings/zmk/mouse.h>
#include <dt-bindings/zmk/ext_power.h>
#include <dt-bindings/zmk/backlight.h>
#include <dt-bindings/zmk/rgb.h>
#include <layouts/foostan/corne/6column.dtsi>
#include "zmk-helpers/helper.h"
#include "zmk-helpers/key-labels/42.h"

#define ___ &trans
#define XXX &none

// Layer aliases
#define DEF 0
#define NUM 1
#define NAV 2

// DEF layer encoder switches
ZMK_BEHAVIOR(enc_sw_left_def, tap_dance,
    tapping-term-ms = <200>;
    bindings = <&kp C_PP>, <&kp C_MUTE>;  // play/pause, mute
)

ZMK_BEHAVIOR(enc_sw_right_def, tap_dance,
    tapping-term-ms = <200>;
    bindings = <&mkp MB4>, <&mkp MB5>;  // mouse back, forward
)

// NUM layer encoder switches  
ZMK_BEHAVIOR(enc_sw_left_num, tap_dance,
    tapping-term-ms = <200>;
    bindings = <&kp LG(TAB)>, <XXX>;  // win+tab, nothing
)

ZMK_BEHAVIOR(enc_sw_right_num, tap_dance,
    tapping-term-ms = <200>;
    bindings = <&kp HOME>, <&kp END>;  // home, end
)

// NAV layer encoder switches
ZMK_BEHAVIOR(enc_sw_left_nav, tap_dance,
    tapping-term-ms = <200>;
    bindings = <&kp LC(X)>, <&kp LC(V)>;  // cut, paste
)

ZMK_BEHAVIOR(enc_sw_right_nav, tap_dance,
    tapping-term-ms = <200>;
    bindings = <&kp LG(TAB)>, <XXX>;  // win+tab, nothing
)

ZMK_COMBO( z,      &kp Z,                        1  2, DEF)
ZMK_COMBO( q,      &kp Q,                        7  8, DEF)

ZMK_BEHAVIOR(ss_cw, tap_dance,
    tapping-term-ms = <200>;
    bindings = <&sk LSHFT>, <&caps_word>;
)

ZMK_BEHAVIOR(tt, hold_tap,
    flavor = "balanced";
    tapping-term-ms = <280>;
    quick-tap-ms = <125>;
    bindings = <&tog>, <&kp>;
)

ZMK_LAYER_3(DEF,
    &kp TAB        &kp J           &kp G           &kp M           &kp P           &kp W            &kp MINUS     &kp U          &kp O         &kp Y         &kp K         &kp BSPC
    &ss_cw         &kp R           &kp S           &kp N           &kp D           &kp B            &kp COMMA     &kp A          &kp E         &kp I         &lt NAV H         &kp Q
    &kp LCTRL      &kp X           &kp F           &kp L           &kp C           &kp V            &kp SEMI      &kp DOT        &kp SLASH     &kp SQT       &kp BSLH      &kp ESC
                                                   &kp Z           &kp T           &mo NUM          &lt NAV RET   &kp SPACE      &kp LALT
    &enc_sw_left_def &enc_sw_right_def,
    &inc_dec_kp C_VOL_UP C_VOL_DN
    &inc_dec_kp SCRL_UP SCRL_DOWN
)

ZMK_LAYER_3(NUM,
    ___            XXX             XXX             XXX             XXX             XXX              &kp GRAVE     &kp LPAR       &kp RPAR      &kp LBRC      &kp RBRC      &kp BSPC
    XXX            &kp N1          &kp N2          &kp N3          &kp N4          &kp N5           &kp N6        &kp N7         &kp N8        &kp N9        &kp N0        &kp EQUAL
    ___            XXX             XXX             XXX             XXX             XXX              XXX           &kp LBKT       &kp RBKT      &kp LT        &kp GT        ___
                                                   XXX             XXX             ___              &kp RET       &kp SPACE      &kp LALT
    &enc_sw_left_num &enc_sw_right_num,
    &inc_dec_kp LA(TAB) LA(LS(TAB))
    &inc_dec_kp PG_UP PG_DN
)

ZMK_LAYER_3(NAV,
    ___            &rgb_ug RGB_EFF &rgb_ug RGB_SPI &rgb_ug RGB_SAI &rgb_ug RGB_HUI &rgb_ug RGB_BRI  &kp PSCRN     &kp HOME       &kp UP        &kp END       &kp INS      &kp DEL
    XXX            &rgb_ug RGB_EFR &rgb_ug RGB_SPD &rgb_ug RGB_SAD &rgb_ug RGB_HUD &rgb_ug RGB_BRD  XXX           &kp LEFT       &kp DOWN      &kp RIGHT     XXX          &kp PG_UP
    ___            &rgb_ug RGB_TOG &bt BT_SEL 0    &bt BT_SEL 1    &bt BT_SEL 3    &bt BT_CLR       XXX           XXX            XXX           XXX           &kp LMETA    &kp PG_DN
                                                   XXX             XXX             ___              &kp RET       &kp SPACE      &kp LALT
    &enc_sw_left_nav &enc_sw_right_nav,
    &inc_dec_kp LC(Z) LC(Y)
    &inc_dec_kp LA(TAB) LA(LS(TAB))
)
